## components/ca_manager/Kconfig
```kconfig
menu "CA manager"

    config CA_UPDATER_STORAGE_LABEL
        string "SPIFFS partition label"
        default "ca_store"

    config CA_UPDATER_SPIFFS_BASE_PATH
        string "SPIFFS mount path"
        default "/spiffs"

    config CA_UPDATER_BUNDLE_FILENAME
        string "Active bundle file"
        default "bundle_ca.bin"

    config CA_UPDATER_VERSION_FILENAME
        string "Active bundle version file"
        default "bundle_ca.version"

    config CA_UPDATER_MAX_BUNDLE_SIZE
        int "Maximum bundle size"
        default 262144

endmenu
```

## components/ca_manifest_updater/Kconfig
```kconfig
menu "CA manifest updater"

    config CA_MANIFEST_UPDATER_MAX_MANIFEST_SIZE
        int "Maximum CA bundle manifest size"
        default 1024

endmenu
```

## components/manifest_file_updater/Kconfig
```kconfig
menu "Manifest file updater"

    config MANIFEST_FILE_UPDATER_HTTP_TIMEOUT_MS
        int "HTTP timeout in milliseconds"
        default 15000

    config MANIFEST_FILE_UPDATER_MAX_REDIRECTS
        int "Maximum HTTP redirects"
        default 5

    config MANIFEST_FILE_UPDATER_DOWNLOAD_BUFFER_SIZE
        int "HTTP download buffer size"
        default 4096

endmenu
```

## main/Kconfig.projbuild
```kconfig
menu "Example consumer app"

    comment "Application-owned settings. Reusable component settings appear in their own menus."

    menu "Wi-Fi"

    config CA_UPDATER_WIFI_SSID
        string "Wi-Fi SSID"
        default ""

    config CA_UPDATER_WIFI_PASSWORD
        string "Wi-Fi password"
        default ""

    endmenu

    menu "CA bundle update"

    config CA_UPDATER_MANIFEST_URL
        string "CA bundle manifest URL"
        default ""
        help
            HTTPS URL that serves a small JSON manifest with version, URL,
            SHA-256, and size for the bundle binary.

    endmenu

    menu "HTTPS diagnostics"

    config CA_UPDATER_BOOT_HTTPS_TEST_URLS
        string "Boot HTTPS diagnostic URLs"
        default "https://maujabur.github.io/mozilla_ca_spiffs_artifacts/ca/stable/bundle_ca.manifest.json"
        help
            Comma-separated HTTPS URLs tested after Wi-Fi connects. This is
            useful when the serial monitor cannot send interactive commands.

    endmenu

endmenu
```

## sdkconfig.defaults
```kconfig
CONFIG_IDF_TARGET="esp32s3"
CONFIG_ESPTOOLPY_FLASHSIZE_8MB=y
CONFIG_PARTITION_TABLE_CUSTOM=y
CONFIG_PARTITION_TABLE_CUSTOM_FILENAME="partitions.csv"
CONFIG_MBEDTLS_CERTIFICATE_BUNDLE=y
CONFIG_MBEDTLS_CERTIFICATE_BUNDLE_DEFAULT_FULL=y
CONFIG_ESP_TLS_INSECURE=n
CONFIG_ESP_TLS_SKIP_SERVER_CERT_VERIFY=n
CONFIG_ESP_MAIN_TASK_STACK_SIZE=8192
CONFIG_ESP_CONSOLE_USB_SERIAL_JTAG=y
CONFIG_SPIFFS_USE_MAGIC=y
CONFIG_SPIFFS_USE_MAGIC_LENGTH=y
CONFIG_MBEDTLS_CERTIFICATE_BUNDLE_CROSS_SIGNED_VERIFY=y
CONFIG_CA_UPDATER_BOOT_HTTPS_TEST_URLS="https://github.com/maujabur/mozilla_ca_spiffs_updater/releases/latest/download/bundle_ca.manifest.json"
```
